## firmware/csi_rx/main/Kconfig.projbuild
```kconfig
menu "CSI RX Configuration"

    config CSI_RX_CHANNEL
        int "WiFi Channel"
        range 1 13
        default 1
        help
            ESP-NOWを受信するチャンネル。csi_txの CSI_TX_CHANNEL と一致させること。

    config CSI_RX_USE_USB_SERIAL_JTAG
        bool "Send CSI over native USB (USB-Serial-JTAG) instead of UART0"
        default n
        help
            有効にすると、CSIフレームをネイティブUSBポート（USB-Serial-JTAG）へ出力する。
            UART0（CP210x等のUSB-UARTブリッジ側）は通常のログ出力に使われる。
            UARTのボーレートでは帯域が足りない場合に使う。

    config CSI_RX_BAUD
        int "UART0 baud rate for CSI frames"
        depends on !CSI_RX_USE_USB_SERIAL_JTAG
        default 921600
        help
            UART0へCSIフレームを出力するときのボーレート。
            サーバー側 --baud と一致させること。起動直後のブートログは115200で出る。

endmenu
```

## firmware/csi_rx/sdkconfig.defaults
```kconfig
CONFIG_IDF_TARGET="esp32s3"
# CSI取得に必須（無効だとesp_wifi_set_csi*が使えない）
CONFIG_ESP_WIFI_CSI_ENABLED=y
CONFIG_FREERTOS_HZ=1000
```

## firmware/csi_tx/main/Kconfig.projbuild
```kconfig
menu "CSI TX Configuration"

    config CSI_TX_ID
        int "TX ID"
        range 0 254
        default 1
        help
            このTX個体のID。書き込み前にデバイスごとに一意な値へ変更すること。
            STAのMACアドレスを 02:C5:15:00:00:<ID> に設定し、csi_rxはこの末尾1バイトで
            TXを識別する（サーバー側のsensor_idと同じ値）。

    config CSI_TX_CHANNEL
        int "WiFi Channel"
        range 1 13
        default 1
        help
            ESP-NOWを送信するチャンネル。csi_rxの CSI_RX_CHANNEL と一致させること。

    config CSI_TX_INTERVAL_MS
        int "Transmit interval (ms)"
        range 1 1000
        default 10
        help
            ESP-NOWフレームの送信間隔。10ms = 約100Hz/台。
            台数が増えて衝突でRXの受信レートが落ちる場合は大きくする。

endmenu
```

## firmware/csi_tx/sdkconfig.defaults
```kconfig
CONFIG_IDF_TARGET="esp32s3"
# 10ms周期の送信タスクを1tick=1msで正確に回すため
CONFIG_FREERTOS_HZ=1000
```
